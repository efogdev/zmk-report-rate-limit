## dts/bindings/behaviors/zmk,behavior-rate-limit.yaml
```yaml
description: Set rate limit in runtime
compatible: "zmk,behavior-rate-limit"
include: one_param.yaml

properties:
  values-ms:
    type: array
    required: true
  feedback-wrap-pattern:
    type: array
  feedback-duration:
    type: int
    default: 0
```

## src/pointing/Kconfig
```kconfig
# Copyright (c) 2023 The ZMK Contributors
# SPDX-License-Identifier: MIT

if ZMK_POINTING

config ZMK_INPUT_PROCESSOR_REPORT_RATE_LIMIT
bool "Pointer rate limiter"
default y

config ZMK_INPUT_PROCESSOR_REPORT_RATE_LIMIT_DEFAULT
int "Rate limiter default sync window, msec"
default 8

config ZIP_RRL_SETTINGS_SAVE_DELAY
int "Settings save debounce, msec"
default 2500

endif
```

## src/shell/Kconfig
```kconfig
if SHELL

config ZMK_RRL_SHELL
bool "Report rate limiter shell commands"
default y

endif
```
